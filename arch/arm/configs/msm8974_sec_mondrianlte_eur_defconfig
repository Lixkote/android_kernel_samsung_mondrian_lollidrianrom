## arch/arm/configs/msm8974_sec_mondrianlte_eur_defconfig
```kconfig
# mondrian lte config
CONFIG_MACH_MONDRIAN=y
CONFIG_MACH_MONDRIAN_LTE=y
CONFIG_MACH_TABPRO=y

# MAXIM 77888
CONFIG_MFD_MAX77888=y
CONFIG_CHARGER_MAX77888=y
CONFIG_REGULATOR_MAX77888=y
CONFIG_MUIC_MAX77888_SUPPORT_SMART_DOCK=y

# HALL SENSOR
CONFIG_SENSORS_HALL=y

CONFIG_FUELGAUGE_MAX17050=y
CONFIG_FUELGAUGE_MAX17050_COULOMB_COUNTING=y

# Earjack
CONFIG_SAMSUNG_JACK=y
CONFIG_INPUT_GPIO=y

# DHA Solution
CONFIG_SEC_DHA_SOL_MAL=y

CONFIG_BATTERY_SAMSUNG=y
CONFIG_SAMSUNG_LPM_MODE=y

# Touchscreen
#CONFIG_TOUCHSCREEN_SYNAPTICS_DSX_I2C is not set
CONFIG_TOUCHSCREEN_SYNAPTICS_I2C_RMI=y

#VIBRATOR
CONFIG_MSM_VIBRATOR=y

#LED
CONFIG_LEDS_QPNP=y

# Display
CONFIG_CABC_TUNING=y
CONFIG_FB_MSM_MIPI_SAMSUNG_TFT_VIDEO_WQXGA_PT_PANEL=y
CONFIG_LCD_CLASS_DEVICE=y
CONFIG_BACKLIGHT_LCD_SUPPORT=y
CONFIG_BACKLIGHT_CLASS_DEVICE=y

#
# Enable Qualcomm Wifi features
#
CONFIG_MSM_PIL_PRONTO=y
CONFIG_WCNSS_CORE=y
CONFIG_WCNSS_CORE_PRONTO=y
CONFIG_WCNSS_MEM_PRE_ALLOC=y

#
# Qualcomm Atheros Prima WLAN module
#
# 
CONFIG_PRIMA_WLAN is not set
CONFIG_PRONTO_WLAN=m
# CONFIG_PRIMA_WLAN_BTAMP is not set
CONFIG_PRIMA_WLAN_LFR=y
CONFIG_PRIMA_WLAN_OKC=y
CONFIG_PRIMA_WLAN_11AC_HIGH_TP=y
CONFIG_WLAN_FEATURE_11W=y
CONFIG_QCOM_VOWIFI_11R=y
CONFIG_ENABLE_LINUX_REG=y
CONFIG_QCOM_TDLS=y


#
# Wifi features (Qualcomm)
#
CONFIG_NET_CORE=y
CONFIG_WIRELESS=y
CONFIG_WIRELESS_EXT_SYSFS=y
CONFIG_WEXT_CORE=y
CONFIG_WEXT_PROC=y
CONFIG_CFG80211=y
CONFIG_CFG80211_WEXT=y
CONFIG_CFG80211_DEFAULT_PS=y
# CONFIG_CFG80211_ALLOW_RECONNECT is not set
CONFIG_WLAN=y
CONFIG_WIRELESS_EXT=y
CONFIG_WEXT_PRIV=y

CONFIG_MODULES=y
CONFIG_MODULE_UNLOAD=y
CONFIG_MODULE_FORCE_UNLOAD=y

#
# Wifi features (Broadcomm)
# CONFIG_BCM4339 is not set
# CONFIG_BCMDHD_FW_PATH is not set
# CONFIG_BCMDHD_NVRAM_PATH is not set
# CONFIG_BROADCOM_WIFI_RESERVED_MEM is not set
# CONFIG_WLAN_REGION_CODE is not set
# CONFIG_MMC_MSM_SDC2_SUPPORT is not set
# CONFIG_H_EUR_WIFI is not set

CONFIG_MHL_VERSION=0x21

#USB
CONFIG_USB_STORAGE_DETECT=y
CONFIG_USB_HOST_NOTIFY=y
CONFIG_USB_DEBUG_DETEAILED_LOG=y

#ethernet driver
CONFIG_USB_NET_SMSC75XX=y
CONFIG_USB_NET_SMSC95XX=y

#SENSOR
CONFIG_STAGING=y
CONFIG_IIO=y
CONFIG_IIO_BUFFER=y
CONFIG_IIO_SW_RING=y
CONFIG_IIO_KFIFO_BUF=y
CONFIG_INV_MPU_IIO=y
# CONFIG_INV_TESTING is not set
CONFIG_SENSORS=y
CONFIG_SENSORS_GP2A030A=y
CONFIG_SENSORS_GP2A030A_PROX=y
CONFIG_SENSORS_SX9500=y
CONFIG_SENSORS_SX9500_INIT_TOUCH_THRESHOLD=3000
CONFIG_SENSORS_SX9500_NORMAL_TOUCH_THRESHOLD=10

CONFIG_SEC_FPGA=y
CONFIG_IR_REMOCON_FPGA=y

CONFIG_MSM_DMA_TEST=y
CONFIG_MEDIA_TUNER_SIMPLE=y
CONFIG_MEDIA_TUNER_TDA8290=y
CONFIG_MEDIA_TUNER_TDA827X=y
CONFIG_MEDIA_TUNER_TDA18271=y
CONFIG_MEDIA_TUNER_TDA9887=y
CONFIG_MEDIA_TUNER_TEA5761=y
CONFIG_MEDIA_TUNER_TEA5767=y
CONFIG_MEDIA_TUNER_MT20XX=y
CONFIG_MEDIA_TUNER_MT2060=y
CONFIG_MEDIA_TUNER_MT2063=y
CONFIG_MEDIA_TUNER_MT2266=y
CONFIG_MEDIA_TUNER_MT2131=y
CONFIG_MEDIA_TUNER_QT1010=y
CONFIG_MEDIA_TUNER_XC2028=y
CONFIG_MEDIA_TUNER_XC5000=y
CONFIG_MEDIA_TUNER_XC4000=y
CONFIG_MEDIA_TUNER_MXL5005S=y
CONFIG_MEDIA_TUNER_MXL5007T=y
CONFIG_MEDIA_TUNER_MC44S803=y
CONFIG_MEDIA_TUNER_MAX2165=y
CONFIG_MEDIA_TUNER_TDA18218=y
CONFIG_MEDIA_TUNER_TDA18212=y
CONFIG_USB_GSPCA=y

#
# Bluetooth device drivers
#
# CONFIG_BT_HCISMD is not set
# CONFIG_BT_HCIBTUSB is not set
# CONFIG_BT_HCIBTSDIO is not set
# CONFIG_BT_HCIUART is not set
# CONFIG_BT_HCIBCM203X is not set
# CONFIG_BT_HCIBPA10X is not set
# CONFIG_BT_MSM_SLEEP is not set
# CONFIG_BT_HCIBFUSB is not set
# CONFIG_BT_HCIVHCI is not set
# CONFIG_BT_MRVL is not set
# CONFIG_MSM_BT_POWER is not set
# CONFIG_AF_RXRPC is not set
CONFIG_FIB_RULES=y
CONFIG_WIRELESS=y
CONFIG_WEXT_CORE=y
CONFIG_WEXT_PROC=y
CONFIG_CFG80211=y
CONFIG_NL80211_TESTMODE=y
# CONFIG_CFG80211_DEVELOPER_WARNINGS is not set
# CONFIG_CFG80211_REG_DEBUG is not set
CONFIG_CFG80211_DEFAULT_PS=y
# CONFIG_CFG80211_DEBUGFS is not set
# CONFIG_CFG80211_INTERNAL_REGDB is not set
CONFIG_CFG80211_WEXT=y
CONFIG_WIRELESS_EXT_SYSFS=y
# CONFIG_LIB80211 is not set
CONFIG_CFG80211_ALLOW_RECONNECT=y
CONFIG_CFG80211_REG_NOT_UPDATED=y
# CONFIG_MAC80211 is not set
# CONFIG_WIMAX is not set
CONFIG_RFKILL=y
CONFIG_RFKILL_PM=y
CONFIG_RFKILL_LEDS=y
# CONFIG_RFKILL_INPUT is not set
# CONFIG_RFKILL_REGULATOR is not set
# CONFIG_RFKILL_GPIO is not set
# CONFIG_NET_9P is not set
# CONFIG_CAIF is not set
# CONFIG_CEPH_LIB is not set
# CONFIG_NFC is not set
# CONFIG_NFC_QNCI is not set

#
# Qualcomm MSM Camera And Video
#
# CONFIG_MSM_CAMERA is not set
CONFIG_MSMB_CAMERA=y
# CONFIG_MSMB_CAMERA_DEBUG is not set
CONFIG_MSM_CAMERA_SENSOR=y
CONFIG_MSM_CPP=y
CONFIG_MSM_CCI=y
# CONFIG_MSM_CSI20_HEADER is not set
CONFIG_MSM_CSI30_HEADER=y
CONFIG_MSM_CSIPHY=y
CONFIG_MSM_CSID=y
CONFIG_MSM_EEPROM=y
CONFIG_MSM_ISPIF=y
# CONFIG_S5K3L1YX is not set
# CONFIG_S5K4E5YA is not set
# CONFIG_IMX134 is not set
CONFIG_IMX135=y
# CONFIG_S5K6B2YX is not set
# CONFIG_OV2720 is not set
# CONFIG_MT9M114 is not set
# CONFIG_MSM_V4L2_VIDEO_OVERLAY_DEVICE is not set
CONFIG_MSMB_JPEG=y
# CONFIG_S5K8B1YX=y is not set
# CONFIG_COMPANION=y is not set
CONFIG_MSM_VIDC_V4L2=y
# CONFIG_MSM_WFD is not set
# CONFIG_SECURE_DEMUX_ENABLE is not set
# CONFIG_MSM_VCAP is not set
CONFIG_MEDIA_TUNER=y
CONFIG_MEDIA_TUNER_CUSTOMISE=y

# SSWAP
CONFIG_SWAP=y
CONFIG_FRONTSWAP=y
CONFIG_ZSMALLOC_NEW=y
CONFIG_PGTABLE_MAPPING=y
CONFIG_ZSWAP=y
CONFIG_DIRECT_RECLAIM_FILE_PAGES_ONLY=n
CONFIG_INCREASE_MAXIMUM_SWAPPINESS=y
CONFIG_FIX_INACTIVE_RATIO=y
CONFIG_TIGHT_PGDAT_BALANCE=y
CONFIG_VNSWAP=y
CONFIG_SWAP_ENABLE_READAHEAD=n
```

## arch/arm/configs/msm8974_sec_mondrianwifi_eur_defconfig
```kconfig
#mondrian wifi config
CONFIG_MACH_MONDRIAN=y
CONFIG_MACH_MONDRIAN_WIFI=y
CONFIG_MACH_MONDRIANWIFI_EUR=y
CONFIG_MACH_TABPRO=y

# MAXIM 77888
CONFIG_MFD_MAX77888=y
CONFIG_CHARGER_MAX77888=y
CONFIG_REGULATOR_MAX77888=y
CONFIG_MUIC_MAX77888_SUPPORT_SMART_DOCK=y

# HALL SENSOR
CONFIG_SENSORS_HALL=y

CONFIG_FUELGAUGE_MAX17050=y
CONFIG_FUELGAUGE_MAX17050_COULOMB_COUNTING=y

# Earjack
CONFIG_SAMSUNG_JACK=y
CONFIG_INPUT_GPIO=y

# DHA Solution
CONFIG_SEC_DHA_SOL_MAL=y

CONFIG_BATTERY_SAMSUNG=y
CONFIG_SAMSUNG_LPM_MODE=y

# Touchscreen
#CONFIG_TOUCHSCREEN_SYNAPTICS_DSX_I2C is not set
CONFIG_TOUCHSCREEN_SYNAPTICS_I2C_RMI=y

#VIBRATOR
CONFIG_MSM_VIBRATOR=y

#LED
CONFIG_LEDS_QPNP=y

# Display
CONFIG_CABC_TUNING=y
CONFIG_FB_MSM_MIPI_SAMSUNG_TFT_VIDEO_WQXGA_PT_PANEL=y
CONFIG_LCD_CLASS_DEVICE=y
CONFIG_BACKLIGHT_LCD_SUPPORT=y
CONFIG_BACKLIGHT_CLASS_DEVICE=y

#
# Enable Qualcomm Wifi features
#
CONFIG_MSM_PIL_PRONTO=y
CONFIG_WCNSS_CORE=y
CONFIG_WCNSS_CORE_PRONTO=y
CONFIG_WCNSS_MEM_PRE_ALLOC=y

#
# Qualcomm Atheros Prima WLAN module
#
# 
CONFIG_PRIMA_WLAN is not set
CONFIG_PRONTO_WLAN=m
# CONFIG_PRIMA_WLAN_BTAMP is not set
CONFIG_PRIMA_WLAN_LFR=y
CONFIG_PRIMA_WLAN_OKC=y
CONFIG_PRIMA_WLAN_11AC_HIGH_TP=y
CONFIG_WLAN_FEATURE_11W=y
CONFIG_QCOM_VOWIFI_11R=y
CONFIG_ENABLE_LINUX_REG=y
CONFIG_QCOM_TDLS=y

#
# Wifi features (Qualcomm)
#
CONFIG_NET_CORE=y
CONFIG_WIRELESS=y
CONFIG_WIRELESS_EXT_SYSFS=y
CONFIG_WEXT_CORE=y
CONFIG_WEXT_PROC=y
CONFIG_CFG80211=y
CONFIG_CFG80211_WEXT=y
CONFIG_CFG80211_DEFAULT_PS=y
# CONFIG_CFG80211_ALLOW_RECONNECT is not set
CONFIG_WLAN=y
CONFIG_WIRELESS_EXT=y
CONFIG_WEXT_PRIV=y

CONFIG_MODULES=y
CONFIG_MODULE_UNLOAD=y
CONFIG_MODULE_FORCE_UNLOAD=y

#
# Wifi features (Broadcomm)
# CONFIG_BCM4339 is not set
# CONFIG_BCMDHD_FW_PATH is not set
# CONFIG_BCMDHD_NVRAM_PATH is not set
# CONFIG_BROADCOM_WIFI_RESERVED_MEM is not set
# CONFIG_WLAN_REGION_CODE is not set
# CONFIG_MMC_MSM_SDC2_SUPPORT is not set
# CONFIG_H_EUR_WIFI is not set

# Input Devices
CONFIG_TOUCHSCREEN_SYNAPTICS_I2C_RMI=y

#SENSOR
CONFIG_STAGING=y
CONFIG_IIO=y
CONFIG_IIO_BUFFER=y
CONFIG_IIO_SW_RING=y
CONFIG_IIO_KFIFO_BUF=y
CONFIG_INV_MPU_IIO=y
# CONFIG_INV_TESTING is not set
CONFIG_SENSORS=y
CONFIG_SENSORS_GP2A030A=y

CONFIG_SEC_FPGA=y
CONFIG_IR_REMOCON_FPGA=y

CONFIG_MHL_VERSION=0x21

#USB
CONFIG_USB_STORAGE_DETECT=y
CONFIG_USB_HOST_NOTIFY=y
CONFIG_USB_DEBUG_DETEAILED_LOG=y

#ethernet driver
CONFIG_USB_NET_SMSC75XX=y
CONFIG_USB_NET_SMSC95XX=y

CONFIG_MSM_DMA_TEST=y
CONFIG_MEDIA_TUNER_SIMPLE=y
CONFIG_MEDIA_TUNER_TDA8290=y
CONFIG_MEDIA_TUNER_TDA827X=y
CONFIG_MEDIA_TUNER_TDA18271=y
CONFIG_MEDIA_TUNER_TDA9887=y
CONFIG_MEDIA_TUNER_TEA5761=y
CONFIG_MEDIA_TUNER_TEA5767=y
CONFIG_MEDIA_TUNER_MT20XX=y
CONFIG_MEDIA_TUNER_MT2060=y
CONFIG_MEDIA_TUNER_MT2063=y
CONFIG_MEDIA_TUNER_MT2266=y
CONFIG_MEDIA_TUNER_MT2131=y
CONFIG_MEDIA_TUNER_QT1010=y
CONFIG_MEDIA_TUNER_XC2028=y
CONFIG_MEDIA_TUNER_XC5000=y
CONFIG_MEDIA_TUNER_XC4000=y
CONFIG_MEDIA_TUNER_MXL5005S=y
CONFIG_MEDIA_TUNER_MXL5007T=y
CONFIG_MEDIA_TUNER_MC44S803=y
CONFIG_MEDIA_TUNER_MAX2165=y
CONFIG_MEDIA_TUNER_TDA18218=y
CONFIG_MEDIA_TUNER_TDA18212=y
CONFIG_USB_GSPCA=y

# SSWAP
CONFIG_SWAP=y
CONFIG_FRONTSWAP=y
CONFIG_ZSMALLOC_NEW=y
CONFIG_PGTABLE_MAPPING=y
CONFIG_ZSWAP=y
CONFIG_DIRECT_RECLAIM_FILE_PAGES_ONLY=n
CONFIG_INCREASE_MAXIMUM_SWAPPINESS=y
CONFIG_FIX_INACTIVE_RATIO=y
CONFIG_TIGHT_PGDAT_BALANCE=y
CONFIG_VNSWAP=y
CONFIG_SWAP_ENABLE_READAHEAD=n

CONFIG_EXTEND_SERIAL_NUM_16=y
```

## drivers/net/wireless/Kconfig
```kconfig
#
# Wireless LAN device configuration
#

menuconfig WLAN
	bool "Wireless LAN"
	depends on !S390
	depends on NET
	select WIRELESS
	default y

if WLAN

config PCMCIA_RAYCS
	tristate "Aviator/Raytheon 2.4GHz wireless support"
	depends on PCMCIA
	select WIRELESS_EXT
	select WEXT_SPY
	select WEXT_PRIV

config LIBERTAS_THINFIRM
	tristate "Marvell 8xxx Libertas WLAN driver support with thin firmware"
	depends on MAC80211
	select FW_LOADER

config LIBERTAS_THINFIRM_DEBUG
	bool "Enable full debugging output in the Libertas thin firmware module."
	depends on LIBERTAS_THINFIRM

config LIBERTAS_THINFIRM_USB
	tristate "Marvell Libertas 8388 USB 802.11b/g cards with thin firmware"
	depends on LIBERTAS_THINFIRM && USB

config AIRO
	tristate "Cisco/Aironet 34X/35X/4500/4800 ISA and PCI cards"
	depends on ISA_DMA_API && (PCI || BROKEN)
	select WIRELESS_EXT
	select CRYPTO
	select WEXT_SPY
	select WEXT_PRIV
config ATMEL
      tristate "Atmel at76c50x chipset  802.11b support"
      depends on (PCI || PCMCIA)
      select WIRELESS_EXT
      select WEXT_PRIV
      select FW_LOADER
      select CRC32
 

config PCI_ATMEL
      tristate "Atmel at76c506 PCI cards"
      depends on ATMEL && PCI

config PCMCIA_ATMEL
	tristate "Atmel at76c502/at76c504 PCMCIA cards"
	depends on ATMEL && PCMCIA
	select WIRELESS_EXT
	select FW_LOADER
	select CRC32


config AT76C50X_USB
        tristate "Atmel at76c503/at76c505/at76c505a USB cards"
        depends on MAC80211 && USB
        select FW_LOADER
   
config AIRO_CS
	tristate "Cisco/Aironet 34X/35X/4500/4800 PCMCIA cards"
	depends on PCMCIA && (BROKEN || !M32R)
	select WIRELESS_EXT
	select WEXT_SPY
	select WEXT_PRIV
	select CRYPTO
	select CRYPTO_AES


config PCMCIA_WL3501
	tristate "Planet WL3501 PCMCIA cards"
	depends on EXPERIMENTAL && PCMCIA
	select WIRELESS_EXT
	select WEXT_SPY


config PRISM54
	tristate 'Intersil Prism GT/Duette/Indigo PCI/Cardbus (DEPRECATED)'
	depends on PCI && EXPERIMENTAL
	select WIRELESS_EXT
	select WEXT_SPY
	select WEXT_PRIV
	select FW_LOADER


config USB_ZD1201
	tristate "USB ZD1201 based Wireless device support"
	depends on USB
	select WIRELESS_EXT
	select WEXT_PRIV
	select FW_LOADER

config USB_NET_RNDIS_WLAN
	tristate "Wireless RNDIS USB support"
	depends on USB && EXPERIMENTAL
	depends on CFG80211
	select USB_USBNET
	select USB_NET_CDCETHER
	select USB_NET_RNDIS_HOST


source "drivers/net/wireless/rtl818x/Kconfig"

config ADM8211
	tristate "ADMtek ADM8211 support"
	depends on MAC80211 && PCI && EXPERIMENTAL
	select CRC32
	select EEPROM_93CX6


config MAC80211_HWSIM
	tristate "Simulated radio testing tool for mac80211"
	depends on MAC80211


config MWL8K
	tristate "Marvell 88W8xxx PCI/PCIe Wireless support"
	depends on MAC80211 && PCI && EXPERIMENTAL


config WIFI_CONTROL_FUNC
	bool "Enable WiFi control function abstraction"


config LIBRA_SDIOIF
	tristate "Qualcomm libra wlan SDIO driver"
	select WIRELESS_EXT
	select WEXT_PRIV
	select WEXT_CORE
	select WEXT_SPY
	depends on MMC_MSM


config ATH6K_LEGACY_EXT
	tristate "QCA AR6003 wlan SDIO driver - External"
	depends on MMC_MSM && WLAN
	select WIRELESS_EXT
	select WEXT_PRIV


config WCNSS_CORE
	tristate "Qualcomm WCNSS CORE driver"
	select WIRELESS_EXT
	select WEXT_PRIV
	select WEXT_CORE
	select WEXT_SPY
	

config WCNSS_CORE_PRONTO
	tristate "Qualcomm WCNSS Pronto Support"
	depends on WCNSS_CORE


config WCNSS_MEM_PRE_ALLOC
	tristate "WCNSS pre-alloc memory support"
	depends on WCNSS_CORE


config WCNSS_REGISTER_DUMP_ON_BITE
	bool "Enable/disable WCNSS register dump when there is a WCNSS bite"
	depends on WCNSS_CORE_PRONTO
	

config WCNSS_IRIS_REGISTER_DUMP
	bool "Enable/disable WCNSS IRIS register dump when there is a WCNSS bite"
	depends on WCNSS_CORE_PRONTO
	

source "drivers/net/wireless/ath/Kconfig"
source "drivers/net/wireless/b43/Kconfig"
source "drivers/net/wireless/b43legacy/Kconfig"
source "drivers/net/wireless/bcmdhd/Kconfig"
source "drivers/net/wireless/bcmdhd/Kconfig"
source "drivers/net/wireless/brcm80211/Kconfig"
source "drivers/net/wireless/hostap/Kconfig"
source "drivers/net/wireless/ipw2x00/Kconfig"
source "drivers/net/wireless/iwlwifi/Kconfig"
source "drivers/net/wireless/iwlegacy/Kconfig"
source "drivers/net/wireless/iwmc3200wifi/Kconfig"
source "drivers/net/wireless/libertas/Kconfig"
source "drivers/net/wireless/orinoco/Kconfig"
source "drivers/net/wireless/p54/Kconfig"
source "drivers/net/wireless/rt2x00/Kconfig"
source "drivers/net/wireless/rtlwifi/Kconfig"
source "drivers/net/wireless/wl1251/Kconfig"
source "drivers/net/wireless/wl12xx/Kconfig"
source "drivers/net/wireless/zd1211rw/Kconfig"
source "drivers/net/wireless/mwifiex/Kconfig"
source "drivers/net/wireless/mwlan_aarp/Kconfig"
source "drivers/net/wireless/prima/Kconfig"

endif # WLAN
```

## drivers/staging/iio/Kconfig
```kconfig
#
# Industrial I/O subsytem configuration
#

menuconfig IIO
	tristate "Industrial I/O support"
	depends on GENERIC_HARDIRQS

if IIO
config IIO_ST_HWMON
	tristate "Hwmon driver that uses channels specified via iio maps"
	depends on HWMON


config IIO_BUFFER
	bool "Enable buffer support within IIO"


if IIO_BUFFER

config IIO_SW_RING
       select IIO_TRIGGER
	tristate "Industrial I/O lock free software ring"

config IIO_KFIFO_BUF
	select IIO_TRIGGER
	tristate "Industrial I/O buffering based on kfifo"


endif # IIO_BUFFER

config IIO_TRIGGER
	boolean "Enable triggered sampling support"


config IIO_CONSUMERS_PER_TRIGGER
       int "Maximum number of consumers per trigger"
       depends on IIO_TRIGGER
       default "2"


source "drivers/staging/iio/accel/Kconfig"
source "drivers/staging/iio/adc/Kconfig"
source "drivers/staging/iio/addac/Kconfig"
source "drivers/staging/iio/cdc/Kconfig"
source "drivers/staging/iio/dac/Kconfig"
source "drivers/staging/iio/dds/Kconfig"
source "drivers/staging/iio/gyro/Kconfig"
source "drivers/staging/iio/impedance-analyzer/Kconfig"
source "drivers/staging/iio/imu/Kconfig"
source "drivers/staging/iio/light/Kconfig"
source "drivers/staging/iio/magnetometer/Kconfig"
source "drivers/staging/iio/meter/Kconfig"
source "drivers/staging/iio/resolver/Kconfig"
source "drivers/staging/iio/trigger/Kconfig"
source "drivers/staging/iio/inv_test/Kconfig"
source "drivers/staging/iio/grip/Kconfig"

config IIO_DUMMY_EVGEN
       tristate

config IIO_SIMPLE_DUMMY
       tristate "An example driver with no hardware requirements"


if IIO_SIMPLE_DUMMY

config IIO_SIMPLE_DUMMY_EVENTS
       boolean "Event generation support"
       select IIO_DUMMY_EVGEN


config IIO_SIMPLE_DUMMY_BUFFER
       boolean "Buffered capture support"
       depends on IIO_KFIFO_BUF


endif # IIO_SIMPLE_DUMMY

endif # IIO
```
