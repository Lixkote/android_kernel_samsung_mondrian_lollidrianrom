## drivers/staging/iio/imu/Kconfig
```kconfig
#
# IIO imu drivers configuration
#
menu "Inertial measurement units"

config ADIS16400
	tristate "Analog Devices ADIS16400 and similar IMU SPI driver"
	depends on SPI
	select IIO_SW_RING if IIO_BUFFER
	select IIO_TRIGGER if IIO_BUFFER

source "drivers/staging/iio/imu/mpu/Kconfig"
endmenu
```

## drivers/staging/iio/imu/mpu/Kconfig
```kconfig
#
# inv-mpu-iio driver for Invensense MPU devices and combos
#

config INV_MPU_IIO
	tristate "Invensense MPU devices"
	depends on I2C && SYSFS && IIO && IIO_KFIFO_BUF && IIO_TRIGGER && !INV_MPU
	default n


config INV_IIO_MPU3050_ACCEL_SLAVE_BMA250
	bool  "Invensense MPU3050 slave accelerometer device for bma250"
	depends on INV_MPU_IIO
	default n
```
